/*
 * PROJECT_LOCAL_SELF_RESEARCH_NOT_GOOGLE_OFFICIAL
 *
 * ZCU104 GestureFlow NPU: device-tree additions for the Linux-side userspace
 * driver.
 *
 * Installed to:
 *   project-spec/meta-user/recipes-bsp/device-tree/files/system-user.dtsi
 *
 * ---------------------------------------------------------------------------
 * NPU scratch buffer: reserved System RAM, mapped Normal Non-Cacheable
 *
 * The NPU's M_AXI master is wired to PS S_AXI_HP0_FPD -- a NON-COHERENT port --
 * so the userspace driver wants the scratch mapped NON-CACHED, with no cache
 * maintenance on either side.
 *
 * Which mapping /dev/mem hands out is decided entirely by whether the physical
 * range is System RAM (arch/arm64/mm/mmap.c phys_mem_access_prot):
 *
 *   !pfn_valid(pfn)       -> pgprot_noncached    = Device-nGnRnE
 *   pfn_valid + O_SYNC    -> pgprot_writecombine = Normal Non-Cacheable
 *   pfn_valid, no O_SYNC  -> cacheable
 *
 * So we keep the range as System RAM (reserved, so the kernel never allocates
 * it) and let the driver's existing O_SYNC open give us the **Normal
 * Non-Cacheable** mapping.  That is what we actually need, because the driver
 * runs memcpy()/memset() over the whole 16 MiB:
 *
 *   Device-nGnRnE permits only accesses of up to 64 bits, and size-aligned.
 *   glibc memset uses DC ZVA and memcpy uses 128-bit STP/LDP -- both undefined
 *   on Device-nGnRnE -> the first access raises SIGBUS with no usable kernel
 *   log.  (Cost a whole debugging round on 2026-09-12.)
 *
 * History, so nobody re-derives it the hard way:
 *   - `no-map` reserved-memory -> memblock_mark_nomap() keeps the range as RAM
 *     but drops it from the linear map; /dev/mem still mapped it cacheable and
 *     the first access hung the CPU (rcu_sched stall).
 *   - a 16 MiB HOLE carved out of the memory node -> pfn_valid() false ->
 *     Device-nGnRnE -> single-word devmem reads/writes worked, but the driver's
 *     memcpy/memset SIGBUS'd.
 *   - this file (plain `reserved-memory`, no no-map, no hole) -> Normal
 *     Non-Cacheable: every access width allowed, still uncached.
 *   See plnx/PITFALLS.md #14.
 *
 * Address choice: 0x70000000 + 16 MiB sits well inside DDR, below the Linux
 * memory node's end (0x7FF00000 = 2 GiB minus the 1 MiB TZ tail) and leaves
 * ~240 MiB of headroom above it.  The NPU master's address space is
 * 0x0 - 0x80000000, so HP0 reaches it.
 *
 * Size: the current network needs ~148 KB of weights and ~425 KB of
 * activations.  16 MB is deliberate over-allocation so the follow-up
 * double-buffered pipeline (capture and compute overlapping) fits.
 *
 * The matching userspace layout is defined in linux/gf_npu.h (GF_BUF_*).
 * ---------------------------------------------------------------------------
 */

/include/ "system-conf.dtsi"

/ {
	reserved-memory {
		#address-cells = <2>;
		#size-cells = <2>;
		ranges;

		/*
		 * GestureFlow NPU scratch: weights blob, input RGB, every
		 * intermediate tensor, and the result area.
		 *
		 * Deliberately WITHOUT `no-map`, and WITHOUT carving a hole in
		 * the memory node: the range must stay System RAM so that
		 * /dev/mem + O_SYNC yields pgprot_writecombine (Normal
		 * Non-Cacheable) rather than Device-nGnRnE.  `reserved-memory`
		 * alone still keeps the kernel from allocating it for anything
		 * else.
		 */
		npu_buffers: npu-buffers@70000000 {
			reg = <0x0 0x70000000 0x0 0x1000000>;	/* 16 MiB */
		};
	};
};
